#include "web.h"

#include <stdio.h>
#include <math.h>
#include <stdlib.h>
#include <string.h>
#include "bridge.h"
#include "esp_app_desc.h"
#include "esp_http_server.h"
#include "esp_log.h"
#include "esp_system.h"
#include "esp_timer.h"
#include "netcfg.h"
#include "ota.h"
#include "printer_link.h"
#include "remote_log.h"
#include "settings.h"
#include "test_label.h"
#include "urlcodec.h"
#include "wifi_prov.h"

static const char *TAG = "web";

#define MAX_SCAN 20
#define BODY_MAX 512
#define SCAN_MAX_AGE_US (60LL * 1000 * 1000)
#define AP_HOME "http://192.168.4.1/"
/* The cached ^HH configuration is re-read when older than this */
#define CFG_MAX_AGE_MS 60000
/*
 * How long a page waits for the printer link. The web server is one task, so
 * a long wait behind a print job would freeze every page; a short one falls
 * back to the cached configuration.
 */
#define CFG_LINK_WAIT_MS 2000
#define CMD_LINK_WAIT_MS 5000

/* Logo mark path on a 64 x 64 grid, from assets/logo/zebserial-mark.svg (generated by make_logo.py). */
#define LOGO_D \
    "M5.8 38.4A5 5 0 0 1 10.6 32L53.4 32A5 5 0 0 1 58.2 38.4L53 56.4A5 5 0 0 1 48.2 60L15.8 60A5 5 0 0 1 11 56.4Z" \
    "M17.5 36L14.5 56L18.5 56L25.5 36ZM30.5 36L27.5 56L31.5 56L38.5 36ZM43.5 36L40.5 56L44.5 56L51.5 36Z" \
    "M19.4 26.1A16 16 0 0 1 44.6 26.1L40.3 29.5A23.1 23.1 0 0 0 23.7 29.5Z" \
    "M9.9 18.8A28 28 0 0 1 54.1 18.8L49.7 22.1A28.6 28.6 0 0 0 14.3 22.1Z"
/* Inline in the page headings; currentColor follows the light/dark text colour. */
#define LOGO_SVG "<svg viewBox='0 0 64 64' fill=currentColor><path fill-rule=evenodd d='" LOGO_D "'/></svg>"

/* A favicon has no page CSS around it, so it carries its own light/dark colours. */
static const char s_favicon[] =
    "<svg xmlns='http://www.w3.org/2000/svg' viewBox='0 0 64 64'>"
    "<style>path{fill:#222}@media(prefers-color-scheme:dark){path{fill:#ddd}}</style>"
    "<path fill-rule='evenodd' d='" LOGO_D "'/></svg>";

static const char PAGE_HEAD[] =
    "<!doctype html><html><head><meta charset=utf-8>"
    "<meta name=viewport content='width=device-width,initial-scale=1'>"
    "<title>ZebSerial</title><link rel=icon href=/favicon.svg><link rel=apple-touch-icon href=/apple-touch-icon.png><style>"
    "body{font-family:system-ui,sans-serif;max-width:32em;margin:1em auto;padding:0 1em;color:#222;background:#fff}"
    "input,select,button{font-size:1em;padding:.4em;margin:.2em 0;width:100%;box-sizing:border-box}"
    "label{display:block;margin-top:.4em}label.check{display:flex;gap:.5em;align-items:baseline}"
    "td{padding:.15em .6em .15em 0;vertical-align:top;white-space:pre-line}td:first-child{opacity:.7}"
    "form.inline{display:inline-block;width:48%}"
    "h2 svg{width:1.6em;height:1.6em;vertical-align:middle;margin:0 .35em .15em 0}"
    "nav{display:flex;gap:1.2em;margin:-.4em 0 1em}nav a[aria-current]{font-weight:bold;color:inherit;text-decoration:none}"
    "fieldset{border:1px solid #8884;margin:1em 0;padding:.5em 1em}label small,td small,p small,h4 small{opacity:.7}"
    "input[type=checkbox]{width:auto}"
    ".danger{color:#b00;border:1px solid #b006}"
    ".note{padding:.5em .8em;border-left:4px solid #2a7;background:#2a71}.note.bad{border-color:#c33;background:#c331}"
    "@media(prefers-color-scheme:dark){body{color:#ddd;background:#181818}"
    "input,select,button{background:#222;color:#ddd;border:1px solid #555}.danger{color:#f77;border-color:#f776}"
    "a{color:#8bf}}"
    "</style></head><body>";
static const char PAGE_TAIL[] = "</body></html>";

static void restart_cb(void *arg)
{
    (void)arg;
    esp_restart();
}

static void restart_soon(void)
{
    static esp_timer_handle_t t;
    if (t == NULL) {
        const esp_timer_create_args_t args = {.callback = restart_cb, .name = "restart"};
        esp_timer_create(&args, &t);
    }
    esp_timer_start_once(t, 1500 * 1000);
}

/*
 * True if the request came in over the setup AP. That network is open to
 * anyone in range, so it only gets the setup page, /save and the favicon.
 */
static bool on_ap(httpd_req_t *req)
{
    return wifi_prov_sock_on_ap(httpd_req_to_sockfd(req));
}

/* Send the captive-portal redirect to the setup page. */
static esp_err_t to_setup_page(httpd_req_t *req)
{
    httpd_resp_set_status(req, "302 Found");
    httpd_resp_set_hdr(req, "Location", AP_HOME);
    return httpd_resp_send(req, NULL, 0);
}

/*
 * Validate Host header to protect against DNS rebinding attacks on the LAN.
 * Captive-portal requests on the setup AP are exempt as phones use arbitrary probe hosts.
 */
static bool host_allowed(httpd_req_t *req)
{
    if (on_ap(req)) {
        return true;
    }
    char host[96];
    if (httpd_req_get_hdr_value_str(req, "Host", host, sizeof(host)) != ESP_OK) {
        return false;
    }
    /* Strip port if present */
    char *colon = strchr(host, ':');
    if (colon != NULL) {
        char *bracket = strrchr(host, ']');
        if (bracket != NULL) {
            colon = strchr(bracket, ':');
        } else if (strchr(colon + 1, ':') != NULL) {
            colon = NULL;
        }
        if (colon != NULL) {
            *colon = '\0';
        }
    }
    if (strcmp(host, "192.168.4.1") == 0) {
        return true;
    }
    char sta_ip[16] = "";
    wifi_prov_ip(sta_ip);
    if (sta_ip[0] != '\0' && strcmp(host, sta_ip) == 0) {
        return true;
    }
    settings_net_t net;
    settings_get_net(&net);
    if (net.hostname[0] != '\0') {
        char local_host[sizeof(net.hostname) + 8];
        snprintf(local_host, sizeof(local_host), "%s.local", net.hostname);
        if (strcasecmp(host, local_host) == 0 || strcasecmp(host, net.hostname) == 0) {
            return true;
        }
    }
    if (strcasecmp(host, "zebserial.local") == 0 || strcasecmp(host, "zebserial") == 0) {
        return true;
    }
    if (host[0] == '[' || strchr(host, ':') != NULL) {
        return true;
    }
    ESP_LOGW(TAG, "refused request with untrusted Host header: %s", host);
    return false;
}

/*
 * CSRF guard for state-changing POSTs: a browser names the page a form came
 * from in Origin (or at least Referer), and it has to be this device as the
 * browser addressed it (the Host header). Requests with neither header (curl,
 * scripts) pass; a page elsewhere cannot make a browser omit both.
 */
static bool same_origin(httpd_req_t *req)
{
    if (!host_allowed(req)) {
        return false;
    }
    char from[192];
    esp_err_t err = httpd_req_get_hdr_value_str(req, "Origin", from, sizeof(from));
    if (err != ESP_OK && err != ESP_ERR_HTTPD_RESULT_TRUNC) {
        err = httpd_req_get_hdr_value_str(req, "Referer", from, sizeof(from));
        if (err != ESP_OK && err != ESP_ERR_HTTPD_RESULT_TRUNC) {
            return true;
        }
    }
    char host[96];
    if (httpd_req_get_hdr_value_str(req, "Host", host, sizeof(host)) != ESP_OK ||
        !url_origin_matches_host(from, host)) {
        ESP_LOGW(TAG, "refused cross-site POST to %s from %s", req->uri, from);
        return false;
    }
    return true;
}

static esp_err_t cross_site(httpd_req_t *req)
{
    return httpd_resp_send_err(req, HTTPD_403_FORBIDDEN, "cross-site request refused");
}

/* Read a form body of at most BODY_MAX bytes into body. On failure the error reply has been sent. */
static bool read_form(httpd_req_t *req, char body[BODY_MAX + 1])
{
    if (req->content_len > BODY_MAX) {
        httpd_resp_send_err(req, HTTPD_400_BAD_REQUEST, "form too large");
        return false;
    }
    int got = 0;
    while (got < (int)req->content_len) {
        int r = httpd_req_recv(req, body + got, req->content_len - got);
        if (r <= 0) {
            httpd_resp_send_err(req, HTTPD_400_BAD_REQUEST, "read failed");
            return false;
        }
        got += r;
    }
    body[got] = '\0';
    return true;
}

/* Minimal HTML escaping for SSIDs. */
static void html_escape(const char *in, char *out, size_t out_len)
{
    size_t o = 0;
    for (; *in && o + 7 < out_len; in++) {
        const char *rep = NULL;
        switch (*in) {
        case '&': rep = "&amp;"; break;
        case '<': rep = "&lt;"; break;
        case '>': rep = "&gt;"; break;
        case '"': rep = "&quot;"; break;
        case '\'': rep = "&#39;"; break;
        default: break;
        }
        if (rep) {
            size_t l = strlen(rep);
            memcpy(out + o, rep, l);
            o += l;
        } else {
            out[o++] = *in;
        }
    }
    out[o] = '\0';
}

typedef enum {
    NAV_STATUS,
    NAV_PRINTER,
    NAV_BRIDGE,
} nav_page_t;

/* Page head, heading and the bar linking the three pages. */
static void send_page_start(httpd_req_t *req, nav_page_t page, const char *title)
{
    httpd_resp_set_type(req, "text/html");
    httpd_resp_sendstr_chunk(req, PAGE_HEAD);
    httpd_resp_sendstr_chunk(req, "<h2>" LOGO_SVG);
    const char *cur = " aria-current=page";
    char buf[256];
    snprintf(buf, sizeof(buf),
             "%s</h2><nav><a href='/'%s>Status</a><a href=/printer%s>Printer</a><a href=/bridge%s>Bridge</a></nav>",
             title, page == NAV_STATUS ? cur : "", page == NAV_PRINTER ? cur : "", page == NAV_BRIDGE ? cur : "");
    httpd_resp_sendstr_chunk(req, buf);
}

static esp_err_t send_page_end(httpd_req_t *req)
{
    httpd_resp_sendstr_chunk(req, PAGE_TAIL);
    return httpd_resp_sendstr_chunk(req, NULL);
}

/* A form's error as a page with a way back. status is e.g. "400 Bad Request"; msg is plain text. */
static esp_err_t fail(httpd_req_t *req, const char *status, const char *msg, const char *back)
{
    httpd_resp_set_status(req, status);
    httpd_resp_set_type(req, "text/html");
    httpd_resp_sendstr_chunk(req, PAGE_HEAD);
    httpd_resp_sendstr_chunk(req, "<h2>" LOGO_SVG "ZebSerial</h2>");
    char esc[400];
    html_escape(msg, esc, sizeof(esc));
    char buf[512];
    snprintf(buf, sizeof(buf), "<p class='note bad'>%s</p><p><a href='%s'>Back</a></p>", esc, back);
    httpd_resp_sendstr_chunk(req, buf);
    return send_page_end(req);
}

static esp_err_t redirect_to(httpd_req_t *req, const char *location)
{
    httpd_resp_set_status(req, "303 See Other");
    httpd_resp_set_hdr(req, "Location", location);
    return httpd_resp_send(req, NULL, 0);
}

typedef struct {
    const char *code;
    const char *text;
} notice_t;

/* The message for a page's ?done=code, from a fixed list so a link cannot put its own text on the page. */
static void send_notice(httpd_req_t *req, const notice_t *list, size_t n)
{
    char q[48];
    char code[24];
    if (httpd_req_get_url_query_str(req, q, sizeof(q)) != ESP_OK ||
        httpd_query_key_value(q, "done", code, sizeof(code)) != ESP_OK) {
        return;
    }
    for (size_t i = 0; i < n; i++) {
        if (strcmp(code, list[i].code) == 0) {
            httpd_resp_sendstr_chunk(req, "<p class=note>");
            httpd_resp_sendstr_chunk(req, list[i].text);
            httpd_resp_sendstr_chunk(req, "</p>");
            return;
        }
    }
}

/*
 * The latest scan. Scanning takes the radio off its channel for about 2 s,
 * so it is repeated only when forced, or when scan_if_stale and the last one
 * is over a minute old.
 */
static int wifi_scan_cached(bool force, bool scan_if_stale, const wifi_ap_record_t **out)
{
    static wifi_ap_record_t recs[MAX_SCAN];
    static int n;
    static int64_t scanned_at;
    int64_t now = esp_timer_get_time();
    if (force || (scan_if_stale && (scanned_at == 0 || now - scanned_at > SCAN_MAX_AGE_US))) {
        int res = wifi_prov_scan(recs, MAX_SCAN);
        if (res > 0) {
            n = res;
            scanned_at = now;
        } else if (scanned_at == 0) {
            n = 0;
        }
    }
    *out = recs;
    return n;
}

/* One <option> per network name in the scan, strongest first as the scan sorts them. */
static void send_ssid_options(httpd_req_t *req, const wifi_ap_record_t *recs, int n)
{
    char esc[200];
    char line[512];
    for (int i = 0; i < n; i++) {
        const char *ssid = (const char *)recs[i].ssid;
        if (ssid[0] == '\0') {
            continue;
        }
        bool dup = false;
        for (int j = 0; j < i; j++) {
            dup |= strcmp(ssid, (const char *)recs[j].ssid) == 0;
        }
        if (dup) {
            continue;
        }
        html_escape(ssid, esc, sizeof(esc));
        snprintf(line, sizeof(line), "<option value=\"%s\">%s (%d dBm)</option>", esc, esc, recs[i].rssi);
        httpd_resp_sendstr_chunk(req, line);
    }
}

static esp_err_t send_setup_page(httpd_req_t *req)
{
    httpd_resp_set_type(req, "text/html");
    httpd_resp_sendstr_chunk(req, PAGE_HEAD);
    httpd_resp_sendstr_chunk(req, "<h2>" LOGO_SVG "ZebSerial WiFi setup</h2><form method=post action=/save>"
                                  "<label>Network</label><select name=ssid>");
    /*
     * Phones fire several captive-portal probes that all land here; scanning
     * on each one disrupts the AP, so reuse a recent scan unless asked.
     */
    char q[16] = "";
    bool want_rescan = httpd_req_get_url_query_str(req, q, sizeof(q)) == ESP_OK && strstr(q, "rescan") != NULL;
    const wifi_ap_record_t *recs;
    int n = wifi_scan_cached(want_rescan, true, &recs);
    send_ssid_options(req, recs, n);
    httpd_resp_sendstr_chunk(req, "</select>"
                                  "<label>or type a network name</label><input name=ssid_manual maxlength=32>"
                                  "<label>Password</label><input name=pass type=password maxlength=64>"
                                  "<button type=submit>Save and reboot</button></form>"
                                  "<p><a href='/?rescan=1'>Scan again</a></p>");
    httpd_resp_sendstr_chunk(req, PAGE_TAIL);
    return httpd_resp_sendstr_chunk(req, NULL);
}

static const char STATUS_HTML[] =
    "<div id=j></div>"
    "<h3>Printer</h3><table id=tp></table>"
    "<h3>Bridge</h3><table id=tb></table>"
    "<h3>Printer configuration</h3><p id=cs>Reading...</p>"
    "<label class=check><input type=checkbox id=raw onchange=draw()> Also show the printer's own wording</label>"
    "<div id=c></div>"
    "<button onclick=cfg(1)>Read the configuration from the printer again</button>";

static const char STATUS_SCRIPT[] =
    "<script>"
    /* status values include printer replies and SSIDs, so escape everything that goes into the table */
    "function e(s){return String(s).replace(/[&<>\"']/g,function(c){return '&#'+c.charCodeAt(0)+';'})}"
    "function row(k,v){return '<tr><td>'+e(k)+'</td><td>'+e(v)+'</td></tr>'}"
    /* ^HH values in SI units, the printer's own text after them; D is dots per mm from RESOLUTION */
    "var D=0,DOTS={'PRINT WIDTH':1,'LABEL LENGTH':1,'LEFT POSITION':1,'TEAR OFF':1,'LABEL TOP':1};"
    "function len(mm){var a=Math.abs(mm),s=mm<0?'-':'';return s+(a<1000?Math.round(a*10)/10+' mm':"
    "a<1e6?Math.round(a/100)/10+' m':Math.round(a/1e4)/100+' km')}"
    "function dpi(d){return d==8?203:d==12?300:d==24?600:Math.round(d*25.4)}"
    "function si(n,v){var x;"
    "if(x=/^(\\d+) IPS$/.exec(v))return Math.round(x[1]*25.4)+' mm/s';"
    "if(x=/^(\\d+) (\\d+)\\/MM/.exec(v))return x[2]+' dots/mm ('+dpi(+x[2])+' dpi), head '+x[1]+' dots = '+len(x[1]/x[2]);"
    "if(x=/(\\d+)MM$/.exec(v))return x[1]+' mm';"
    "if(x=/^([\\d,]+(\\.\\d+)?) ?IN$/.exec(v))return len(parseFloat(x[1].replace(/,/g,''))*25.4);"
    "if(D&&DOTS[n]&&/^[+-]?\\d+$/.test(v))return (+v)+' dots = '+len(v/D);"
    "return null}"
    /* names for lines the printer form does not change; UI (from the firmware) names the ones it does */
    "var FN={'SENSOR TYPE':'Media sensing',"
    "'WEB S.':'Gap sensor: gap reading','MEDIA S.':'Gap sensor: label reading','WEB GAIN':'Gap sensor gain',"
    "'MARK S.':'Mark sensor: mark reading','MARK MED S.':'Mark sensor: media reading','MARK GAIN':'Mark sensor gain',"
    "'MARK MEDIA GAIN':'Mark sensor media gain','CONT MEDIA S.':'Continuous media reading',"
    "'CONT MEDIA GAIN':'Continuous media gain','RIBBON OUT':'Ribbon-out threshold','RIBBON GAIN':'Ribbon sensor gain',"
    "'TAKE LABEL':'Label-taken sensor threshold','ONBOARD FLASH':'Onboard flash',"
    "'BAUD':'Serial speed','DATA BITS':'Data bits','PARITY':'Parity','HOST HANDSHAKE':'Handshake','PROTOCOL':'Protocol',"
    "'SER COMM. MODE':'Serial port mode','USB COMM.':'USB port','PARALLEL COMM.':'Parallel port',"
    "'CONTROL CHAR':'Control command prefix','COMMAND CHAR':'Format command prefix','DELIM. CHAR':'Delimiter',"
    "'FIRMWARE':'Firmware','HARDWARE ID':'Hardware ID','SERIAL NUMBER':'Serial number','RESOLUTION':'Resolution',"
    "'XML SCHEMA':'XML schema','CONFIGURATION':'Configuration','ZBI VERSION':'ZBI version',"
    "'FORMAT CONVERT':'Format conversion','MODES ENABLED':'Modes enabled','MODES DISABLED':'Modes disabled',"
    "'HEXDUMP':'Hex dump','HEAD USAGE':'Printhead usage','TOTAL USAGE':'Total printed','RESET CNTR1':'User counter 1',"
    "'RESET CNTR2':'User counter 2','LAST CLEANED':'Since the head was cleaned'};"
    "function has(o,k){return Object.prototype.hasOwnProperty.call(o,k)}"
    "function nm(k){return has(UI,k)?UI[k][0]:has(FN,k)?FN[k]:k}"
    "var ST={'WEB':'gaps between labels','MARK':'black marks','CONTINUOUS':'continuous media'};"
    "var LN={'zpl':'ZPL','epl_zpl':'ZPL and EPL','hybrid_xml_zpl':'ZPL and XML','epl':'EPL','line_print':'Line print',"
    "'cpcl':'CPCL'};"
    "var PIN={21:'D3',23:'D5'};function pin(g){return (has(PIN,g)?PIN[g]+' ':'')+'(GPIO'+g+')'}"
    /* sensors and lines the printer is not using with this media, print method and mode are dimmed */
    "function unused(k,m){var t=m['MEDIA TYPE']||'';"
    "if(/^(WEB S\\.|MEDIA S\\.|WEB GAIN)$/.test(k))return /GAP|NOTCH|WEB/.test(t)?'':'not used with this media';"
    "if(/^MARK/.test(k))return /MARK/.test(t)?'':'used for black-mark media only';"
    "if(/^CONT /.test(k))return /CONT/.test(t)?'':'used for continuous media only';"
    "if(/^RIBBON/.test(k))return /DIRECT/.test(m['PRINT METHOD']||'')?'not used in direct thermal mode':'';"
    "if(k=='TAKE LABEL')return /PEEL/.test(m['PRINT MODE']||'')?'':'used in peel-off mode only';"
    "return ''}"
    "function nice(k,v){var x;"
    "if(k=='FIRMWARE')return v.replace(/\\s*<-$/,'');"
    "if(x=/^(\\d+)k[ .]*([A-Z]):$/.exec(v))return x[1]+' KB';"
    "if(k=='SENSOR TYPE'&&ST[v])return ST[v];"
    "if(/ S\\.$|^RIBBON OUT$|^TAKE LABEL$/.test(k)&&/^\\d+$/.test(v))return (+v)+' of 100';"
    "if(/GAIN$/.test(k)&&/^\\d+$/.test(v))return ''+(+v);"
    "return si(k,v)}"
    /* a setting the printer form changes reads as the form does: its option text, or its number (and mm) */
    "function val(k,v){if(has(UI,k)&&has(C,k)){var u=UI[k],c=C[k];if(has(u[3],c))return u[3][c];"
    "if(u[2])return D?len(c/D)+' ('+c+' dots)':c+' dots';if(!Object.keys(u[3]).length)return c}return nice(k,v)}"
    /* one clean value per row; the printer's own name and text in the tooltip, or under it when asked */
    "function srow(k,v,m){var s=val(k,v),u=m?unused(k,m):'',t=k+': '+v;if(s==null)s=v;"
    "return '<tr title=\"'+e(t)+'\"'+(u?' style=opacity:.45':'')+'><td>'+e(nm(k))+'</td><td>'+e(s)+"
    "(u?' <small>('+e(u)+')</small>':'')+(RAW?'<br><small>'+e(t)+'</small>':'')+'</td></tr>'}"
    /* where the gap and label readings sit on the 0 to 100 scale */
    "function sbar(m){var w=+m['WEB S.'],l=+m['MEDIA S.'];"
    "if(!(w>=0&&l>=0&&w<=100&&l<=100)||!/GAP|NOTCH|WEB/.test(m['MEDIA TYPE']||''))return '';"
    "function d(x,c,t){return '<circle cx='+(4+x)+' cy=6 r=2.5 fill='+c+' />'+"
    "'<text x='+(4+x)+' y=15 font-size=4.5 text-anchor=middle fill=currentColor>'+t+' '+x+'</text>'}"
    "return '<p><small>Sensor readings are on the printer\\'s 0 to 100 scale and are set when it calibrates "
    "(Calibrate media on the Printer page). The further apart the gap and label readings, the more easily "
    "it tells them apart.</small></p><svg viewBox=\"0 0 108 17\" style=\"width:100%;max-width:26em\">'+"
    "'<line x1=4 y1=6 x2=104 y2=6 stroke=currentColor stroke-opacity=.3 stroke-width=1.5 />'+"
    "d(w,'#c60','gap')+d(l,'#06c','label')+'</svg>'}"
    "function dur(s){var d=Math.floor(s/86400),h=Math.floor(s%86400/3600),m=Math.floor(s%3600/60);"
    "return (d?d+'d ':'')+(d||h?h+'h ':'')+m+'m'}"
    "function flags(h){var f=[];for(var k in h)if(h[k]===true)f.push(k.replace('_',' '));return f.length?f.join(', '):'ok'}"
    "function id(x){return document.getElementById(x)}"
    /* J: the last Wi-Fi join state seen, H: the hostname, for when the bridge stops answering mid-join */
    "var J='',H='zebserial';"
    "function join(w){var j=w.join,t;J=j.state;if(!J){id('j').innerHTML='';return}"
    "t=J=='trying'?'Trying network '+j.ssid+'. If it cannot join within 30 s the bridge goes back to '+w.ssid+'.':"
    "J=='joined'?'Joined '+j.ssid+'.':'Could not join '+j.ssid+(j.why?' ('+j.why+')':'')+'; still on '+w.ssid+'.';"
    "id('j').innerHTML='<p class=\"note'+(J=='failed'?' bad':'')+'\">'+e(t)+'</p>'}"
    "async function upd(){try{var s=await(await fetch('/api/status')).json();var p=s.printer,b=s.bridge,w=s.wifi;"
    "H=w.hostname;join(w);"
    "id('tp').innerHTML="
    "row('Printer',p.detected?((p.model?p.model+', ':'')+(p.answering?'answering':"
    "'not answering for '+dur(Math.round(p.reply_age_ms/1000))+' (paper or ribbon out, head open, or switched off?)')+"
    "(p.sleeps?', sleeps when idle (asked at most every 30 s while this page is open)':'')):"
    "('not detected (trying '+p.baud+' baud)'))+"
    "(p.language?row('Language',(has(LN,p.language)?LN[p.language]:p.language)+"
    "(p.zpl?'':' (not ZPL: jobs pass through, settings unavailable)')):'')+"
    "row('Status',p.hs_valid?flags(p.hs)+' ('+Math.round(p.hs_age_ms/1000)+' s ago)':'unknown')+"
    "row('Serial link',p.baud+' baud, '+(SER?SER+', ':'')+(p.handshake||'handshake unknown')+'\\nTX '+pin(p.tx_gpio)+', RX '+pin(p.rx_gpio)+"
    "(s.config.target_baud&&s.config.target_baud!=p.baud?'\\nset to '+s.config.target_baud+' baud on the Bridge page':''));"
    "id('tb').innerHTML="
    "row('Wi-Fi',w.ip?w.ssid+', '+w.rssi+' dBm'+(w.phy?', '+w.phy:'')+(w.channel?', channel '+w.channel:''):"
    "'not connected'+(w.ssid?' (trying '+w.ssid+')':''))+"
    "(w.bssid?row('Access point',w.bssid):'')+"
    "row('Address',w.hostname+'.local, '+(w.ip||'no address')+(w.static_ip?' (static)':' (DHCP)'))+"
    "row('IPv6',w.ip6.length?w.ip6.join('\\n'):'none')+"
    "row('Print client',b.active?('printing from '+b.client_ip):('idle, last '+(b.client_ip||'none')))+"
    "row('Jobs',b.sessions+' ('+b.aborted+' dropped)')+"
    "row('Bytes',b.to_printer+' to printer, '+b.from_printer+' back')+"
    "row('Remote log',!s.rlog.enabled?'off':(s.rlog.listener?'sending to an iot_log receiver':'no receiver found')+"
    "', '+s.rlog.sent+' lines sent')+"
    "row('Uptime',dur(s.uptime_s))+"
    "row('Firmware',s.version+' '+s.built)}"
    "catch(x){if(J=='trying')id('j').innerHTML='<p class=note>No reply from the bridge. If it joined the new network, '+"
    "'connect to that network and open http://'+e(H)+'.local/</p>'}}"
    /* a hidden tab stops asking: each /api/status request has a printer that sleeps asked again */
    "upd();setInterval(function(){if(!document.hidden)upd()},2000);"
    "document.addEventListener('visibilitychange',function(){if(!document.hidden)upd()});"
    /* ^HH names by group, as the Printer page groups its form; names this list does not know go under Other */
    "var G=[['Print',['DARKNESS','PRINT SPEED','PRINT METHOD','PRINT MODE','PRINT WIDTH','LABEL LENGTH','TEAR OFF',"
    "'LABEL TOP','LEFT POSITION','BACKFEED']],"
    "['Media',['MEDIA TYPE','SENSOR SELECT','MAXIMUM LENGTH','MEDIA POWER UP','HEAD CLOSE']],"
    "['Communications',['SER COMM. MODE','USB COMM.',"
    "'PARALLEL COMM.','CONTROL CHAR','COMMAND CHAR','DELIM. CHAR','ZPL MODE']],"
    "['Sensors',['SENSOR TYPE','WEB S.','MEDIA S.','WEB GAIN','MARK S.','MARK GAIN','MARK MED S.',"
    "'MARK MEDIA GAIN','CONT MEDIA S.','CONT MEDIA GAIN','RIBBON OUT','RIBBON GAIN','TAKE LABEL']],"
    "['Firmware and hardware',['FIRMWARE','HARDWARE ID','SERIAL NUMBER','RESOLUTION','RAM','ONBOARD FLASH',"
    "'XML SCHEMA','CONFIGURATION','ZBI','ZBI VERSION','FORMAT CONVERT','MODES ENABLED','MODES DISABLED','HEXDUMP']],"
    "['Usage and maintenance',['HEAD USAGE','TOTAL USAGE','RESET CNTR1','RESET CNTR2','LAST CLEANED','EARLY WARNING']]];"
    /* the serial settings show once, in the Serial link row; SER is their text from the printer's own list */
    "var LC=null,C={},RAW=false,SER='',SERN=['BAUD','DATA BITS','PARITY','HOST HANDSHAKE','PROTOCOL'];"
    "function ser(m,b){var t=[],x;if(x=/^(\\d+)/.exec(m['DATA BITS']||''))t.push(x[1]+' data bits');"
    "if(m['PARITY'])t.push(m['PARITY']=='NONE'?'no parity':m['PARITY'].toLowerCase()+' parity');"
    "if(m['PROTOCOL']&&m['PROTOCOL']!='NONE')t.push('protocol '+m['PROTOCOL'].toLowerCase());"
    "return t.join(', ')}"
    "function draw(){RAW=id('raw').checked;if(!LC)return;var c=LC;"
    "var m=Object.create(null),seen=Object.create(null),h='',o='';c.pairs.forEach(function(p){if(!(p[0] in m))m[p[0]]=p[1]});"
    "var r=/ (\\d+)\\/MM/.exec(m['RESOLUTION']||'');D=r?+r[1]:0;C=c.cfg||{};"
    "SER=ser(m);SERN.forEach(function(n){seen[n]=1});"
    "G.forEach(function(g){var t='',ch=false;g[1].forEach(function(n){if(n in m){t+=srow(n,m[n],m);seen[n]=1;"
    "if(has(UI,n)&&has(C,n))ch=true}});"
    "if(t)h+='<h4>'+e(g[0])+(ch?' <small><a href=\"/printer#g-'+g[0].split(' ')[0].toLowerCase()+'\">change</a></small>':'')+"
    "'</h4>'+(g[0]=='Sensors'?sbar(m):'')+'<table>'+t+'</table>'});"
    "c.pairs.forEach(function(p){if(!seen[p[0]])o+=srow(p[0],p[1],m)});"
    "if(o)h+='<h4>Other</h4><table>'+o+'</table>';"
    "id('c').innerHTML=h}"
    "async function cfg(r){var st=id('cs');st.textContent='Reading...';"
    "try{var c=await(await fetch('/api/printer_config'+(r?'?refresh=1':''))).json();LC=c;draw();"
    "st.textContent=(c.error?c.error+'. ':'')+(c.age_ms>=0?'Read from the printer '+Math.round(c.age_ms/1000)+' s ago. '"
    "+'Hold the pointer over a row to see the wording the printer uses.':'')"
    "}catch(x){st.textContent='Could not load the printer configuration.'}}"
    "cfg(0)"
    "</script>";

static void send_ui_script(httpd_req_t *req);

static esp_err_t root_get(httpd_req_t *req)
{
    if (on_ap(req)) {
        return send_setup_page(req);
    }
    if (!host_allowed(req)) {
        return cross_site(req);
    }
    send_page_start(req, NAV_STATUS, "ZebSerial");
    httpd_resp_sendstr_chunk(req, STATUS_HTML);
    send_ui_script(req);
    httpd_resp_sendstr_chunk(req, STATUS_SCRIPT);
    return send_page_end(req);
}

static esp_err_t save_post(httpd_req_t *req)
{
    if (!same_origin(req)) {
        return cross_site(req);
    }
    char body[BODY_MAX + 1];
    if (!read_form(req, body)) {
        return ESP_FAIL;
    }

    char ssid[SETTINGS_SSID_MAX] = "";
    char manual[SETTINGS_SSID_MAX] = "";
    char pass[SETTINGS_PASS_MAX] = "";
    form_get(body, "ssid", ssid, sizeof(ssid));
    form_get(body, "ssid_manual", manual, sizeof(manual));
    form_get(body, "pass", pass, sizeof(pass));
    memset(body, 0, sizeof(body));
    if (manual[0] != '\0') {
        strlcpy(ssid, manual, sizeof(ssid));
    }
    if (ssid[0] == '\0') {
        return fail(req, "400 Bad Request", "No network chosen.", "/");
    }
    if (pass[0] != '\0' && strlen(pass) < 8) {
        return fail(req, "400 Bad Request", "WPA passwords are at least 8 characters.", "/");
    }
    esp_err_t err = settings_set_wifi(ssid, pass);
    memset(pass, 0, sizeof(pass));
    if (err != ESP_OK) {
        return fail(req, "500 Internal Server Error", "Could not save the network.", "/");
    }
    ESP_LOGI(TAG, "saved WiFi network \"%s\", rebooting", ssid);
    httpd_resp_set_type(req, "text/html");
    httpd_resp_sendstr_chunk(req, PAGE_HEAD);
    httpd_resp_sendstr_chunk(req, "<p>Saved. Rebooting and joining the network. "
                                  "Then open <a href='http://zebserial.local/'>http://zebserial.local/</a>.</p>");
    httpd_resp_sendstr_chunk(req, PAGE_TAIL);
    httpd_resp_sendstr_chunk(req, NULL);
    restart_soon();
    return ESP_OK;
}

static esp_err_t status_get(httpd_req_t *req)
{
    if (on_ap(req)) {
        return to_setup_page(req);
    }
    if (!host_allowed(req)) {
        return cross_site(req);
    }
    printer_status_t p;
    bridge_stats_t b;
    printer_link_want_status();  /* a printer that sleeps is only asked while someone is looking */
    printer_link_get_status(&p);
    bridge_get_stats(&b);
    char ip[16];
    wifi_prov_ip(ip);
    /* SSIDs and printer replies can hold anything: a 32-byte SSID of control characters is 192 bytes escaped */
    char ssid_esc[32 * 6 + 1];
    json_escape(wifi_prov_ssid(), ssid_esc, sizeof(ssid_esc));
    const esp_app_desc_t *app = esp_app_get_description();
    char version_esc[sizeof(app->version) * 6];
    json_escape(app->version, version_esc, sizeof(version_esc));

    char phy[24];
    int channel;
    char bssid[18];
    wifi_prov_link(phy, sizeof(phy), &channel, bssid);

    settings_net_t net;
    settings_options_t opt;
    settings_get_net(&net);
    settings_get_options(&opt);
    remote_log_status_t rl;
    remote_log_get_status(&rl);
    ota_status_t ota;
    ota_get_status(&ota);
    char other_esc[sizeof(ota.other_version) * 6];
    json_escape(ota.other_version, other_esc, sizeof(other_esc));
    char handshake_esc[sizeof(p.handshake) * 6];
    json_escape(p.handshake, handshake_esc, sizeof(handshake_esc));
    char model_esc[sizeof(p.model) * 6];
    json_escape(p.model, model_esc, sizeof(model_esc));
    char lang_esc[sizeof(p.language) * 6];
    json_escape(p.language, lang_esc, sizeof(lang_esc));
    char hostname_esc[sizeof(net.hostname) * 6];
    json_escape(net.hostname, hostname_esc, sizeof(hostname_esc));
    char join_ssid[SETTINGS_SSID_MAX];
    const char *join_why;
    wifi_join_state_t join = wifi_prov_join_state(join_ssid, &join_why);
    static const char *const join_names[] = {"", "trying", "joined", "failed"};
    char join_esc[32 * 6 + 1];
    json_escape(join_ssid, join_esc, sizeof(join_esc));
    char ip6[WIFI_PROV_IP6_MAX][46];
    int n6 = wifi_prov_ip6(ip6);
    char ip6_json[WIFI_PROV_IP6_MAX * 50 + 4] = "[";
    for (int i = 0; i < n6; i++) {
        size_t l = strlen(ip6_json);
        snprintf(ip6_json + l, sizeof(ip6_json) - l, "%s\"%s\"", i ? "," : "", ip6[i]);
    }
    strlcat(ip6_json, "]", sizeof(ip6_json));

    const size_t json_cap = 3072;
    char *json = malloc(json_cap);
    if (json == NULL) {
        return httpd_resp_send_err(req, HTTPD_500_INTERNAL_SERVER_ERROR, "out of memory");
    }
    int json_len = snprintf(json, json_cap,
             "{\"wifi\":{\"ssid\":\"%s\",\"ip\":\"%s\",\"rssi\":%d,\"phy\":\"%s\",\"channel\":%d,\"bssid\":\"%s\",\"hostname\":\"%s\",\"static_ip\":%s,"
             "\"ip6\":%s,\"join\":{\"state\":\"%s\",\"ssid\":\"%s\",\"why\":\"%s\"}},"
             "\"config\":{\"target_baud\":%lu,\"pins\":%d,\"idle_timeout_s\":%u},"
             "\"printer\":{\"detected\":%s,\"answering\":%s,\"reply_age_ms\":%lld,\"sleeps\":%s,\"model\":\"%s\","
             "\"language\":\"%s\",\"zpl\":%s,\"baud\":%lu,\"handshake\":\"%s\",\"tx_gpio\":%d,\"rx_gpio\":%d,"
             "\"hs_valid\":%s,\"hs_age_ms\":%lld,\"hs\":{\"paper_out\":%s,\"pause\":%s,\"head_up\":%s,"
             "\"ribbon_out\":%s,\"partial_format\":%s,\"buffer_full\":%s,\"corrupt_ram\":%s,\"under_temp\":%s,\"over_temp\":%s,"
             "\"formats_in_buffer\":%d},\"tx_bytes\":%llu,\"rx_bytes\":%llu},"
             "\"bridge\":{\"active\":%s,\"client_ip\":\"%s\",\"sessions\":%lu,\"aborted\":%lu,"
             "\"to_printer\":%llu,\"from_printer\":%llu},"
             "\"rlog\":{\"enabled\":%s,\"listener\":%s,\"sent\":%lu,\"dropped\":%lu},"
             "\"ota\":{\"running\":\"%s\",\"pending\":%s,\"other_version\":\"%s\"},"
             "\"uptime_s\":%lld,\"version\":\"%s\",\"built\":\"%s %s\"}",
             ssid_esc, ip, wifi_prov_rssi(), phy, channel, bssid, hostname_esc, net.static_ip ? "true" : "false", ip6_json,
             join_names[join], join_esc, join_why,
             (unsigned long)opt.target_baud, (int)opt.pins, (unsigned)opt.idle_timeout_s, p.detected ? "true" : "false",
             p.answering ? "true" : "false", (long long)p.reply_age_ms,
             p.sleeps ? "true" : "false", model_esc, lang_esc, p.zpl ? "true" : "false", (unsigned long)p.baud, handshake_esc,
             p.tx_gpio, p.rx_gpio, p.hs_valid ? "true" : "false", (long long)p.hs_age_ms,
             p.hs.paper_out ? "true" : "false", p.hs.pause ? "true" : "false", p.hs.head_up ? "true" : "false",
             p.hs.ribbon_out ? "true" : "false", p.hs.partial_format ? "true" : "false",
             p.hs.buffer_full ? "true" : "false",
             p.hs.corrupt_ram ? "true" : "false", p.hs.under_temp ? "true" : "false",
             p.hs.over_temp ? "true" : "false", p.hs.formats_in_buffer, (unsigned long long)p.tx_bytes,
             (unsigned long long)p.rx_bytes, b.active ? "true" : "false", b.client_ip, (unsigned long)b.sessions,
             (unsigned long)b.aborted, (unsigned long long)b.bytes_to_printer,
             (unsigned long long)b.bytes_from_printer, rl.enabled ? "true" : "false", rl.listener ? "true" : "false",
             (unsigned long)rl.sent, (unsigned long)rl.dropped, ota.running, ota.pending ? "true" : "false",
             other_esc, (long long)(esp_timer_get_time() / 1000000), version_esc,
             app->date, app->time);
    if (json_len < 0 || (size_t)json_len >= json_cap) {
        free(json);
        ESP_LOGE(TAG, "status JSON needs %d bytes, buffer is %u", json_len, (unsigned)json_cap);
        return httpd_resp_send_err(req, HTTPD_500_INTERNAL_SERVER_ERROR, "status too long");
    }
    httpd_resp_set_type(req, "application/json");
    httpd_resp_set_hdr(req, "Cache-Control", "no-store");
    esp_err_t err = httpd_resp_send(req, json, json_len);
    free(json);
    return err;
}

/*
 * The cached printer configuration, read again from the printer when older
 * than CFG_MAX_AGE_MS, missing, or when refresh is set. *have says whether
 * hh holds a configuration (perhaps an old one). Returns why the printer
 * could not be read, or NULL.
 */
static const char *printer_config(zpl_hh_t *hh, bool refresh, bool *have, int64_t *age_ms)
{
    *have = printer_link_get_config(hh, age_ms);
    if (!refresh && *have && *age_ms <= CFG_MAX_AGE_MS) {
        return NULL;
    }
    switch (printer_link_refresh_config(pdMS_TO_TICKS(CFG_LINK_WAIT_MS))) {
    case ESP_OK:
        *have = printer_link_get_config(hh, age_ms);
        return NULL;
    case ESP_ERR_TIMEOUT:
        return "Printer busy (printing or being detected)";
    case ESP_ERR_INVALID_STATE:
        return "Printer not detected, or holding output paused";
    case ESP_ERR_NOT_SUPPORTED:
        return "The printer is not in a ZPL language (see Language on the status page), so its settings cannot be read";
    case ESP_ERR_NO_MEM:
        return "Out of memory";
    default:
        return "No complete reply to ^HH from the printer";
    }
}

/* GET /api/printer_config[?refresh=1]: the printer's ^HH settings as [name, value] pairs. */
static esp_err_t printer_config_get(httpd_req_t *req)
{
    if (on_ap(req)) {
        return to_setup_page(req);
    }
    if (!host_allowed(req)) {
        return cross_site(req);
    }
    char q[16] = "";
    bool refresh = httpd_req_get_url_query_str(req, q, sizeof(q)) == ESP_OK && strstr(q, "refresh=1") != NULL;
    zpl_hh_t *hh = malloc(sizeof(*hh));
    if (hh == NULL) {
        return httpd_resp_send_err(req, HTTPD_500_INTERNAL_SERVER_ERROR, "out of memory");
    }
    bool have;
    int64_t age_ms = -1;
    const char *error = printer_config(hh, refresh, &have, &age_ms);
    if (!have) {
        hh->count = 0;
        age_ms = -1;
    }
    httpd_resp_set_type(req, "application/json");
    httpd_resp_set_hdr(req, "Cache-Control", "no-store");
    /* one pair at a time; each escape can grow a byte to six, so a pair always fits */
    char line[(ZPL_HH_NAME_LEN + ZPL_HH_VALUE_LEN) * 6 + 16];
    snprintf(line, sizeof(line), "{\"age_ms\":%lld,\"error\":%s%s%s,\"pairs\":[", (long long)age_ms,
             error ? "\"" : "", error ? error : "null", error ? "\"" : "");
    httpd_resp_sendstr_chunk(req, line);
    for (int i = 0; i < hh->count; i++) {
        char name[ZPL_HH_NAME_LEN * 6];
        char value[ZPL_HH_VALUE_LEN * 6];
        json_escape(hh->pair[i].name, name, sizeof(name));
        json_escape(hh->pair[i].value, value, sizeof(value));
        snprintf(line, sizeof(line), "%s[\"%s\",\"%s\"]", i ? "," : "", name, value);
        httpd_resp_sendstr_chunk(req, line);
    }
    /* the settings the printer form changes, decoded as the form's values, so the status page words them alike */
    httpd_resp_sendstr_chunk(req, "],\"cfg\":{");
    zpl_printer_cfg_t cur;
    zpl_cfg_from_hh(hh, &cur);
    free(hh);
    int k = 0;
    for (int f = 0; f < ZPL_CFG_COUNT; f++) {
        if (cur.known & (1u << f)) {
            char text[16];
            zpl_cfg_format((zpl_cfg_field_t)f, cur.v[f], text, sizeof(text));
            snprintf(line, sizeof(line), "%s\"%s\":\"%s\"", k++ ? "," : "", zpl_cfg_desc((zpl_cfg_field_t)f)->hh_name,
                     text);
            httpd_resp_sendstr_chunk(req, line);
        }
    }
    httpd_resp_sendstr_chunk(req, "}}");
    return httpd_resp_sendstr_chunk(req, NULL);
}

/*
 * Form controls for the printer settings, in page order. The groups and
 * labels are the status page's too (send_ui_script), so a setting has one
 * name and one wording everywhere. options: "value=Label|..." or NULL for a
 * number.
 */
typedef struct {
    zpl_cfg_field_t field;
    const char *group;      /* as in the status page's G list */
    const char *label;
    const char *unit;       /* "dots" or "dot rows": a number also shown in mm; NULL otherwise */
    const char *options;
} printer_field_ui_t;

#define FEED_OPTIONS "F=Feed|C=Calibrate|L=Measure length|N=No motion"
static const printer_field_ui_t s_printer_ui[] = {
    {ZPL_CFG_DARKNESS, "Print", "Darkness", NULL, NULL},
    {ZPL_CFG_SPEED, "Print", "Print speed", NULL,
     "2=51 mm/s (2 ips)|3=76 mm/s (3 ips)|4=102 mm/s (4 ips)|5=127 mm/s (5 ips)|6=152 mm/s (6 ips)"},
    {ZPL_CFG_METHOD, "Print", "Print method", NULL, "D=Direct thermal|T=Thermal transfer"},
    {ZPL_CFG_MODE, "Print", "Print mode", NULL, "T=Tear off|P=Peel off|R=Rewind|C=Cutter|D=Delayed cut"},
    {ZPL_CFG_WIDTH, "Print", "Print width", "dots", NULL},
    {ZPL_CFG_LENGTH, "Print", "Label length", "dots", NULL},
    {ZPL_CFG_TEAR_OFF, "Print", "Tear-off adjust", "dot rows", NULL},
    {ZPL_CFG_LABEL_TOP, "Print", "Label top", "dot rows", NULL},
    {ZPL_CFG_LEFT_POS, "Print", "Left position", "dots", NULL},
    {ZPL_CFG_BACKFEED, "Print", "Backfeed",
     NULL, "N=Default (90% after printing)|A=After printing|B=Before the next label|O=Off|"
           "10=10% after|20=20% after|30=30% after|40=40% after|50=50% after|60=60% after|"
           "70=70% after|80=80% after|90=90% after"},
    {ZPL_CFG_MEDIA, "Media", "Media type", NULL, "Y=Gap/notch|M=Mark|N=Continuous"},
    {ZPL_CFG_SENSOR, "Media", "Media type detection", NULL,
     "A=Automatic, found when it calibrates|M=Fixed, as set in Media type"},
    {ZPL_CFG_MAX_LENGTH, "Media", "Maximum label length", "dots", NULL},
    {ZPL_CFG_POWER_UP, "Media", "Media at power up", NULL, FEED_OPTIONS},
    {ZPL_CFG_HEAD_CLOSE, "Media", "Media at head close", NULL, FEED_OPTIONS},
    {ZPL_CFG_ZPL_MODE, "Communications", "ZPL mode", NULL, "2=ZPL II|1=ZPL"},
    {ZPL_CFG_EARLY_WARNING, "Usage and maintenance", "Head maintenance early warning", NULL, "D=Off|E=On"},
};
#define PRINTER_UI_COUNT (sizeof(s_printer_ui) / sizeof(s_printer_ui[0]))

/* Calls fn(value, value_len, text, text_len) for each "value=Label" in options. */
#define FOR_EACH_OPTION(options, value, vlen, text, tlen, body)                    \
    for (const char *o_ = (options); *o_ != '\0';) {                               \
        const char *bar_ = strchr(o_, '|');                                         \
        size_t len_ = bar_ ? (size_t)(bar_ - o_) : strlen(o_);                      \
        const char *eq_ = memchr(o_, '=', len_);                                    \
        if (eq_ != NULL) {                                                          \
            const char *value = o_;                                                 \
            size_t vlen = (size_t)(eq_ - o_);                                       \
            const char *text = eq_ + 1;                                             \
            size_t tlen = len_ - vlen - 1;                                          \
            body                                                                    \
        }                                                                           \
        o_ += len_;                                                                 \
        if (*o_ == '|') {                                                           \
            o_++;                                                                   \
        }                                                                           \
    }

/*
 * var UI={'^HH name':[label, group, in dots, {value: option text}], ...}
 * for the status page. The labels and options hold no quote or backslash.
 */
static void send_ui_script(httpd_req_t *req)
{
    char buf[160];
    httpd_resp_sendstr_chunk(req, "<script>var UI={");
    for (size_t i = 0; i < PRINTER_UI_COUNT; i++) {
        const printer_field_ui_t *ui = &s_printer_ui[i];
        snprintf(buf, sizeof(buf), "%s'%s':['%s','%s',%d,{", i ? "," : "", zpl_cfg_desc(ui->field)->hh_name, ui->label,
                 ui->group, ui->unit != NULL);
        httpd_resp_sendstr_chunk(req, buf);
        if (ui->options != NULL) {
            bool first = true;
            FOR_EACH_OPTION(ui->options, value, vlen, text, tlen, {
                snprintf(buf, sizeof(buf), "%s'%.*s':'%.*s'", first ? "" : ",", (int)vlen, value, (int)tlen, text);
                httpd_resp_sendstr_chunk(req, buf);
                first = false;
            })
        }
        httpd_resp_sendstr_chunk(req, "}]");
    }
    httpd_resp_sendstr_chunk(req, "};</script>");
}

/*
 * Dots as mm to 0.01 mm, trailing zeros dropped: fine enough to give the
 * same dot count back at up to 24 dots/mm, so an unchanged field stays
 * unchanged.
 */
static void fmt_mm_exact(int dots, int dpmm, char *out, size_t out_len)
{
    int h = (abs(dots) * 100 + dpmm / 2) / dpmm;
    const char *sign = dots < 0 && h > 0 ? "-" : "";
    if (h % 100 == 0) {
        snprintf(out, out_len, "%s%d", sign, h / 100);
    } else if (h % 10 == 0) {
        snprintf(out, out_len, "%s%d.%d", sign, h / 100, h % 100 / 10);
    } else {
        snprintf(out, out_len, "%s%d.%02d", sign, h / 100, h % 100);
    }
}

/* One labelled control, prefilled with the printer's current value. Options the printer cannot take are left out. */
static void send_printer_field(httpd_req_t *req, const zpl_printer_cfg_t *cur, const printer_field_ui_t *ui)
{
    const zpl_cfg_desc_t *d = zpl_cfg_desc(ui->field);
    char cur_text[16];
    zpl_cfg_format(ui->field, cur->v[ui->field], cur_text, sizeof(cur_text));
    char buf[640];
    if (ui->options == NULL) {
        int min;
        int max;
        zpl_cfg_range(cur, ui->field, &min, &max);
        if (ui->unit != NULL && cur->dpmm > 0) {
            /* typed in mm (the name ends _mm), with the dot count it comes to alongside */
            char lo[16];
            char hi[16];
            char now[16];
            fmt_mm_exact(min, cur->dpmm, lo, sizeof(lo));
            fmt_mm_exact(max, cur->dpmm, hi, sizeof(hi));
            fmt_mm_exact(cur->v[ui->field], cur->dpmm, now, sizeof(now));
            snprintf(buf, sizeof(buf),
                     "<label for=f_%s>%s <small>(mm, %s to %s; <span id=dt_%s>%s %s</span>)</small>"
                     "</label><input id=f_%s name=%s_mm type=number min=%s max=%s step=any value=%s "
                     "oninput=\"document.getElementById('dt_%s').textContent=Math.round(this.value*%d)+' %s'\">",
                     d->key, ui->label, lo, hi, d->key, cur_text, ui->unit, d->key, d->key, lo, hi, now, d->key,
                     cur->dpmm, ui->unit);
            httpd_resp_sendstr_chunk(req, buf);
            return;
        }
        snprintf(buf, sizeof(buf),
                 "<label for=f_%s>%s <small>(%s%s%d to %d)</small></label>"
                 "<input id=f_%s name=%s type=number min=%d max=%d step=1 value=%s>",
                 d->key, ui->label, ui->unit ? ui->unit : "", ui->unit ? ", " : "", min, max, d->key, d->key, min, max,
                 cur_text);
        httpd_resp_sendstr_chunk(req, buf);
        return;
    }
    snprintf(buf, sizeof(buf), "<label for=f_%s>%s</label><select id=f_%s name=%s>", d->key, ui->label, d->key,
             d->key);
    httpd_resp_sendstr_chunk(req, buf);
    FOR_EACH_OPTION(ui->options, value, vlen, text, tlen, {
        char v_text[8];
        int v;
        if (vlen < sizeof(v_text)) {
            memcpy(v_text, value, vlen);
            v_text[vlen] = '\0';
            if (zpl_cfg_parse(cur, ui->field, v_text, &v)) {
                snprintf(buf, sizeof(buf), "<option value=%s%s>%.*s</option>", v_text,
                         v == cur->v[ui->field] ? " selected" : "", (int)tlen, text);
                httpd_resp_sendstr_chunk(req, buf);
            }
        }
    })
    httpd_resp_sendstr_chunk(req, "</select>");
}

/* "g-print" for "Print": the anchor the status page's group headings link to. */
static void group_anchor(const char *group, char *out, size_t out_len)
{
    size_t o = strlcpy(out, "g-", out_len);
    for (const char *g = group; *g != '\0' && *g != ' ' && o + 1 < out_len; g++) {
        out[o++] = (char)(*g >= 'A' && *g <= 'Z' ? *g - 'A' + 'a' : *g);
    }
    out[o] = '\0';
}

/* The printer's settings form, grouped as on the status page. */
static void send_printer_form(httpd_req_t *req)
{
    zpl_hh_t *hh = malloc(sizeof(*hh));
    zpl_printer_cfg_t *cur = malloc(sizeof(*cur));
    bool have = false;
    int64_t age_ms = -1;
    const char *error = "Out of memory";
    if (hh != NULL && cur != NULL) {
        error = printer_config(hh, false, &have, &age_ms);
    }
    char buf[512];
    char esc[ZPL_HH_VALUE_LEN * 6];
    httpd_resp_sendstr_chunk(req, "<form method=post action=/printer_config>");
    if (error != NULL) {
        snprintf(buf, sizeof(buf), "<p class='note bad'>%s.%s <a href=/printer>Try again</a></p>", error,
                 have ? " These values are from an earlier reading." : "");
        httpd_resp_sendstr_chunk(req, buf);
    }
    if (have) {
        zpl_cfg_from_hh(hh, cur);
        const char *group = NULL;
        for (size_t i = 0; i < PRINTER_UI_COUNT; i++) {
            const printer_field_ui_t *ui = &s_printer_ui[i];
            if (!(cur->known & (1u << ui->field))) {
                continue;
            }
            if (group == NULL || strcmp(group, ui->group) != 0) {
                char anchor[24];
                group_anchor(ui->group, anchor, sizeof(anchor));
                snprintf(buf, sizeof(buf), "%s<fieldset id=%s><legend>%s</legend>", group ? "</fieldset>" : "", anchor,
                         ui->group);
                httpd_resp_sendstr_chunk(req, buf);
                group = ui->group;
            }
            send_printer_field(req, cur, ui);
        }
        if (group != NULL) {
            httpd_resp_sendstr_chunk(req, "</fieldset>");
        }
        /* the bridge depends on these, so they are shown, not offered */
        /* names as the Status page's FN table gives them */
        static const char *const serial[][2] = {{"BAUD", "serial speed"}, {"DATA BITS", "data bits"},
                                                {"PARITY", "parity"}, {"HOST HANDSHAKE", "handshake"},
                                                {"PROTOCOL", "protocol"}};
        httpd_resp_sendstr_chunk(req, "<p><small>Serial port:");
        bool first = true;
        for (size_t i = 0; i < sizeof(serial) / sizeof(serial[0]); i++) {
            const char *v = zpl_hh_get(hh, serial[i][0]);
            if (v != NULL) {
                html_escape(v, esc, sizeof(esc));
                snprintf(buf, sizeof(buf), "%s %s %s", first ? "" : ",", serial[i][1], esc);
                httpd_resp_sendstr_chunk(req, buf);
                first = false;
            }
        }
        httpd_resp_sendstr_chunk(req, ". The bridge sets these; its speed is under Serial link on the "
                                      "<a href=/bridge>Bridge</a> page.</small></p>"
                                      "<button type=submit>Send to printer</button>");
    }
    httpd_resp_sendstr_chunk(req, "</form>");
    free(hh);
    free(cur);
}

/* A one-button form posting action to /printer_action; confirm (no quotes) asks first when not NULL. */
static void send_action(httpd_req_t *req, const char *action, const char *label, const char *confirm, bool danger)
{
    char buf[640];
    snprintf(buf, sizeof(buf),
             "<form class=inline method=post action=/printer_action%s%s%s><input type=hidden name=action value=%s>"
             "<button%s>%s</button></form> ",
             confirm ? " onsubmit=\"return confirm('" : "", confirm ? confirm : "", confirm ? "')\"" : "", action,
             danger ? " class=danger" : "", label);
    httpd_resp_sendstr_chunk(req, buf);
}

/* The two user counters: what they count, and what zeroing one leaves alone */
static void send_counter_reset(httpd_req_t *req, int which)
{
    char label[32];
    char confirm[300];
    char action[24];
    snprintf(action, sizeof(action), "reset_counter%d", which);
    snprintf(label, sizeof(label), "Zero user counter %d", which);
    snprintf(confirm, sizeof(confirm),
             "Set user counter %d to zero? The printer has two counters of the media it prints that you can zero "
             "yourself, for example at a new roll or the start of a job. Total printed and printhead usage are "
             "not changed.",
             which);
    send_action(req, action, label, confirm, true);
}

static const notice_t s_printer_notices[] = {
    {"sent", "Sent to the printer and saved there."},
    {"same", "Nothing was changed, so nothing was sent."},
    {"calibrate", "Calibrating: the printer feeds labels while it measures them."},
    {"feed", "Fed one label."},
    {"config_label", "Printing the configuration label."},
    {"reset_counter1", "User counter 1 set to zero."},
    {"reset_counter2", "User counter 2 set to zero."},
    {"reset_head_cleaned", "Head cleaning recorded."},
    {"reload_saved", "The printer reloaded its saved settings."},
    {"factory_defaults", "Factory defaults restored. The bridge is finding the printer again to set its serial port."},
    {"redetect", "Finding the printer again."},
    {"test_label", "Printing the test label."},
};

/*
 * The test label form, its size prefilled from the printer's print width
 * and label length (the last ^HH reading; a print job's own ^PW and ^LL may
 * have changed them since, so they can be edited).
 */
static void send_test_label_form(httpd_req_t *req)
{
    zpl_hh_t *hh = malloc(sizeof(*hh));
    zpl_printer_cfg_t cfg = {0};
    int64_t age_ms;
    if (hh != NULL && printer_link_get_config(hh, &age_ms)) {
        zpl_cfg_from_hh(hh, &cfg);
    }
    free(hh);
    char w[12] = "";
    char l[12] = "";
    if (cfg.dpmm > 0 && (cfg.known & (1u << ZPL_CFG_WIDTH))) {
        snprintf(w, sizeof(w), "%.1f", (double)cfg.v[ZPL_CFG_WIDTH] / cfg.dpmm);
    }
    if (cfg.dpmm > 0 && (cfg.known & (1u << ZPL_CFG_LENGTH))) {
        snprintf(l, sizeof(l), "%.1f", (double)cfg.v[ZPL_CFG_LENGTH] / cfg.dpmm);
    }
    char buf[900];
    snprintf(buf, sizeof(buf),
             "<fieldset><legend>Test label</legend>"
             "<p><small>A border 1 mm in from the edges, mm rulers, line widths, a solid band (white streaks are dead "
             "printhead dots), a 20 mm circle (an oval means the wrong dpi) and two barcodes. Nothing is saved in "
             "the printer. The size starts as the printer's print width and label length; a print job may have "
             "changed those, so set your label's size.</small></p>"
             "<form method=post action=/printer_test>"
             "<label for=tw>Width <small>(mm)</small></label><input id=tw name=w inputmode=decimal required value='%s'>"
             "<label for=tl>Length <small>(mm)</small></label><input id=tl name=l inputmode=decimal required value='%s'>"
             "<button>Print test label</button></form></fieldset>",
             w, l);
    httpd_resp_sendstr_chunk(req, buf);
}

/* GET /printer: the printer's own settings and maintenance. */
static esp_err_t printer_get_page(httpd_req_t *req)
{
    if (on_ap(req)) {
        return to_setup_page(req);
    }
    if (!host_allowed(req)) {
        return cross_site(req);
    }
    send_page_start(req, NAV_PRINTER, "Printer settings");
    send_notice(req, s_printer_notices, sizeof(s_printer_notices) / sizeof(s_printer_notices[0]));
    httpd_resp_sendstr_chunk(req, "<p><small>These settings are kept in the printer and sent to it over the serial "
                                  "link; only changed values are sent, then saved in the printer. The bridge's own "
                                  "settings are on the <a href=/bridge>Bridge</a> page.</small></p>");
    send_printer_form(req);
    httpd_resp_sendstr_chunk(req, "<fieldset><legend>Routine</legend>");
    send_action(req, "feed", "Feed one label", NULL, false);
    send_action(req, "calibrate", "Calibrate media", "Calibrate the media sensors? The printer feeds several labels.",
                false);
    send_action(req, "config_label", "Print configuration label", NULL, false);
    send_action(req, "reset_head_cleaned", "Mark head cleaned", "Record that the printhead has just been cleaned?",
                false);
    httpd_resp_sendstr_chunk(req, "<form class=inline method=post action=/redetect><button>Re-detect printer</button>"
                                  "</form></fieldset>");
    send_test_label_form(req);
    httpd_resp_sendstr_chunk(req, "<fieldset><legend>Reset</legend>");
    send_counter_reset(req, 1);
    send_counter_reset(req, 2);
    send_action(req, "reload_saved", "Reload saved settings",
                "Discard unsaved printer changes and reload its saved settings?", true);
    send_action(req, "factory_defaults", "Restore factory defaults",
                "Restore the printer to factory defaults and save them? This also resets its serial port; "
                "the bridge then finds it again and sets its serial speed and XON/XOFF.",
                true);
    httpd_resp_sendstr_chunk(req, "</fieldset>");
    return send_page_end(req);
}

static void ip_str(uint32_t v, char out[16])
{
    if (v == 0) {
        out[0] = '\0';
        return;
    }
    snprintf(out, 16, "%lu.%lu.%lu.%lu", (unsigned long)(v >> 24), (unsigned long)(v >> 16 & 255),
             (unsigned long)(v >> 8 & 255), (unsigned long)(v & 255));
}

static const notice_t s_bridge_notices[] = {
    {"saved", "Saved."},
};

/* The Wi-Fi part of the bridge page: the latest join, the network, and joining another. */
static void send_wifi_section(httpd_req_t *req, const settings_net_t *net)
{
    char buf[1024];
    char cur[32 * 6 + 1];
    html_escape(wifi_prov_ssid(), cur, sizeof(cur));
    char join_ssid[SETTINGS_SSID_MAX];
    char join_esc[32 * 6 + 1];
    const char *why;
    wifi_join_state_t join = wifi_prov_join_state(join_ssid, &why);
    html_escape(join_ssid, join_esc, sizeof(join_esc));
    if (join == WIFI_JOIN_TRYING) {
        snprintf(buf, sizeof(buf), "<p class=note>Trying network %s. <a href=/>The status page</a> shows the result.</p>",
                 join_esc);
        httpd_resp_sendstr_chunk(req, buf);
    } else if (join == WIFI_JOIN_JOINED) {
        snprintf(buf, sizeof(buf), "<p class=note>Joined %s.</p>", join_esc);
        httpd_resp_sendstr_chunk(req, buf);
    } else if (join == WIFI_JOIN_FAILED) {
        snprintf(buf, sizeof(buf), "<p class='note bad'>Could not join %s%s%s%s; still on %s.</p>", join_esc,
                 why[0] ? " (" : "", why, why[0] ? ")" : "", cur);
        httpd_resp_sendstr_chunk(req, buf);
    }

    char q[16] = "";
    bool scan = httpd_req_get_url_query_str(req, q, sizeof(q)) == ESP_OK && strstr(q, "scan=1") != NULL;
    const wifi_ap_record_t *recs;
    int n = wifi_scan_cached(scan, false, &recs);
    snprintf(buf, sizeof(buf),
             "<form method=post action=/wifi_join><fieldset id=wifi><legend>Wi-Fi</legend>"
             "<p>Connected to <b>%s</b>, %d dBm.</p>"
             "<label for=ssid>Network <small>(<a href='/bridge?scan=1#wifi'>scan for networks</a>; "
             "a scan pauses Wi-Fi for about 2 s)</small></label>"
             "<input id=ssid name=ssid list=nets maxlength=32 required value=\"%s\"><datalist id=nets>",
             cur, wifi_prov_rssi(), cur);
    httpd_resp_sendstr_chunk(req, buf);
    send_ssid_options(req, recs, n);
    snprintf(buf, sizeof(buf),
             "</datalist><label for=pass>Password <small>(blank for an open network)</small></label>"
             "<input id=pass name=pass type=password maxlength=64>"
             "<p><small>The bridge tries the network for up to 30 s and keeps it only if it gets an address there; "
             "otherwise it goes back to %s. If it joins, connect to that network and open "
             "<a href='http://%s.local/'>http://%s.local/</a>.%s</small></p>"
             "<button type=submit>Join</button></fieldset></form>",
             cur, net->hostname, net->hostname,
             net->static_ip ? " The static address below is kept: switch to DHCP first if the new network uses "
                              "other addresses."
                            : "");
    httpd_resp_sendstr_chunk(req, buf);
    snprintf(buf, sizeof(buf),
             "<form method=post action=/forget onsubmit=\"return confirm('Forget this Wi-Fi network? The bridge "
             "restarts as the open setup network %s.')\"><button class=danger>Forget Wi-Fi and start setup mode"
             "</button></form>",
             wifi_prov_ap_ssid());
    httpd_resp_sendstr_chunk(req, buf);
}

/* Firmware version, upload and going back: the Bridge page's last section. */
static void send_firmware_section(httpd_req_t *req, const char *hostname)
{
    ota_status_t st;
    ota_get_status(&st);
    char ver[sizeof(st.version) * 6];
    char other[sizeof(st.other_version) * 6];
    html_escape(st.version, ver, sizeof(ver));
    html_escape(st.other_version, other, sizeof(other));
    char buf[1600];
    snprintf(buf, sizeof(buf),
             "<fieldset id=fw><legend>Firmware</legend>"
             "<p>Running %s (%s)%s.</p>"
             "<label for=fwf>New firmware <small>(build/zebserial.bin from <code>idf.py build</code>)</small></label>"
             "<input type=file id=fwf accept=.bin> <button type=button id=fwb>Upload and restart</button> "
             "<span id=fwm></span>"
             "<p><small>The new firmware has %d s to reach the network after it starts, or the bridge goes back to "
             "this one. From a terminal: <code>curl --data-binary @build/zebserial.bin http://%s.local/update</code>"
             "</small></p>",
             ver, st.running, st.pending ? ", new and not yet confirmed" : "", 180, hostname);
    httpd_resp_sendstr_chunk(req, buf);
    if (st.other_version[0] != '\0') {
        snprintf(buf, sizeof(buf),
                 "<form method=post action=/boot_other onsubmit=\"return confirm('Restart into the other firmware?')\">"
                 "<button class=danger>Go back to %s</button></form>",
                 other);
        httpd_resp_sendstr_chunk(req, buf);
    }
    httpd_resp_sendstr_chunk(req,
        "</fieldset><script>"
        "document.getElementById('fwb').onclick=function(){"
        "var f=document.getElementById('fwf').files[0],m=document.getElementById('fwm');"
        "if(!f){m.textContent='Choose the .bin file first.';return}"
        "var x=new XMLHttpRequest();x.open('POST','/update');"
        "x.upload.onprogress=function(e){if(e.lengthComputable)m.textContent='Uploading '+Math.round(100*e.loaded/e.total)+' %'};"
        "var b=this;"
        "x.onload=function(){m.textContent=x.responseText;if(x.status==200)setTimeout(function(){location.reload()},20000);"
        "else b.disabled=false};"
        "x.onerror=function(){m.textContent='The upload failed.';b.disabled=false};"
        "b.disabled=true;x.send(f)}"
        "</script>");
}

/* GET /bridge: the bridge's own settings, kept in its flash. */
static esp_err_t bridge_get_page(httpd_req_t *req)
{
    if (on_ap(req)) {
        return to_setup_page(req);
    }
    if (!host_allowed(req)) {
        return cross_site(req);
    }
    settings_options_t opt;
    settings_net_t net;
    settings_get_options(&opt);
    settings_get_net(&net);
    char ip[16];
    char mask[16];
    char gw[16];
    char dns[16];
    ip_str(net.ip, ip);
    ip_str(net.mask, mask);
    ip_str(net.gw, gw);
    ip_str(net.dns, dns);

    send_page_start(req, NAV_BRIDGE, "Bridge settings");
    send_notice(req, s_bridge_notices, sizeof(s_bridge_notices) / sizeof(s_bridge_notices[0]));
    httpd_resp_sendstr_chunk(req, "<p><small>Settings of the ZebSerial bridge itself, kept in the bridge. "
                                  "The printer's settings are on the <a href=/printer>Printer</a> page.</small></p>");
    send_wifi_section(req, &net);

    const char *off = net.static_ip ? "" : " disabled";
    char buf[1536];
    snprintf(buf, sizeof(buf),
             "<form method=post action=/config>"
             "<fieldset><legend>Network</legend>"
             "<label for=hostname>Hostname <small>(lower case, digits, hyphens; reached as name.local)</small></label>"
             "<input id=hostname name=hostname maxlength=32 pattern='[a-z0-9]([a-z0-9-]*[a-z0-9])?' value='%s'>"
             "<label class=check><input type=checkbox name=static value=1%s "
             "onchange=\"for(var i of document.querySelectorAll('.sip'))i.disabled=!this.checked\"> Static IPv4 address "
             "<small>(otherwise DHCP; IPv6 is automatic)</small></label>"
             "<label for=ip>Address</label><input class=sip id=ip name=ip value='%s' placeholder='192.168.1.50'%s>"
             "<label for=mask>Netmask</label><input class=sip id=mask name=mask value='%s' placeholder='255.255.255.0'%s>"
             "<label for=gw>Gateway</label><input class=sip id=gw name=gw value='%s' placeholder='192.168.1.1'%s>"
             "<label for=dns>DNS <small>(blank uses the gateway)</small></label>"
             "<input class=sip id=dns name=dns value='%s'%s></fieldset>",
             net.hostname, net.static_ip ? " checked" : "", ip, off, mask, off, gw, off, dns, off);
    httpd_resp_sendstr_chunk(req, buf);
    snprintf(buf, sizeof(buf),
             "<fieldset id=link><legend>Serial link to the printer</legend>"
             "<label for=baud>Speed <small>(the bridge moves the printer to this when it finds it)</small></label>"
             "<select id=baud name=baud>"
             "<option value=115200%s>115200 baud</option><option value=57600%s>57600 baud</option>"
             "<option value=38400%s>38400 baud</option><option value=19200%s>19200 baud</option>"
             "<option value=9600%s>9600 baud</option><option value=0%s>Leave the printer as it is</option></select>",
             opt.target_baud == 115200 ? " selected" : "", opt.target_baud == 57600 ? " selected" : "",
             opt.target_baud == 38400 ? " selected" : "", opt.target_baud == 19200 ? " selected" : "",
             opt.target_baud == 9600 ? " selected" : "", opt.target_baud == 0 ? " selected" : "");
    httpd_resp_sendstr_chunk(req, buf);
    snprintf(buf, sizeof(buf),
             "<label for=pins>Pins</label><select id=pins name=pins>"
             "<option value=0%s>Detect at boot</option>"
             "<option value=1%s>TX on D3 (GPIO21), RX on D5 (GPIO23)</option>"
             "<option value=2%s>TX on D5 (GPIO23), RX on D3 (GPIO21)</option></select>"
             "<label for=idle>Close an idle print connection after <small>(seconds, %d to %d)</small></label>"
             "<input id=idle name=idle type=number min=%d max=%d value=%u></fieldset>",
             opt.pins == SETTINGS_PINS_AUTO ? " selected" : "", opt.pins == SETTINGS_PINS_TX_D3 ? " selected" : "",
             opt.pins == SETTINGS_PINS_TX_D5 ? " selected" : "", SETTINGS_IDLE_MIN_S, SETTINGS_IDLE_MAX_S,
             SETTINGS_IDLE_MIN_S, SETTINGS_IDLE_MAX_S, (unsigned)opt.idle_timeout_s);
    httpd_resp_sendstr_chunk(req, buf);
    settings_rlog_t rlog;
    settings_get_rlog(&rlog);
    snprintf(buf, sizeof(buf),
             "<fieldset id=rlog><legend>Remote log</legend>"
             "<label class=check><input type=checkbox name=rlog value=1%s> Send the bridge's log to an "
             "<a href='https://github.com/Bwooce/esp-iot-log'>iot_log</a> receiver "
             "<small>(only while one is found on the network)</small></label>"
             "<label for=rlog_lvl>Level</label><select id=rlog_lvl name=rlog_lvl>"
             "<option value=1%s>Errors</option><option value=2%s>Warnings and errors</option>"
             "<option value=3%s>Everything (information, warnings and errors)</option></select></fieldset>"
             "<p><small>Changing the hostname, the address or the pins restarts the bridge.</small></p>"
             "<button type=submit>Save</button></form>"
             "<p><small>Holding the BOOT button for 5 s clears the Wi-Fi and network settings.</small></p>",
             rlog.enabled ? " checked" : "", rlog.level == 1 ? " selected" : "", rlog.level == 2 ? " selected" : "",
             rlog.level == 3 ? " selected" : "");
    httpd_resp_sendstr_chunk(req, buf);
    send_firmware_section(req, net.hostname);
    return send_page_end(req);
}

/* The old combined settings page's address. */
static esp_err_t settings_get_page(httpd_req_t *req)
{
    if (on_ap(req)) {
        return to_setup_page(req);
    }
    return redirect_to(req, "/printer");
}

static esp_err_t config_post(httpd_req_t *req)
{
    if (on_ap(req)) {
        return to_setup_page(req);
    }
    if (!same_origin(req)) {
        return cross_site(req);
    }
    char body[BODY_MAX + 1];
    if (!read_form(req, body)) {
        return ESP_FAIL;
    }

    settings_options_t old_opt;
    settings_net_t old_net;
    settings_get_options(&old_opt);
    settings_get_net(&old_net);
    settings_options_t opt = old_opt;
    settings_net_t net = old_net;
    char v[40];

    if (form_get(body, "baud", v, sizeof(v))) {
        opt.target_baud = (uint32_t)strtoul(v, NULL, 10);
    }
    if (form_get(body, "pins", v, sizeof(v))) {
        opt.pins = (settings_pins_t)atoi(v);
    }
    if (form_get(body, "idle", v, sizeof(v))) {
        long idle = strtol(v, NULL, 10);
        opt.idle_timeout_s = (idle < 0 || idle > 65535) ? 0 : (uint16_t)idle;
    }
    if (form_get(body, "hostname", v, sizeof(v))) {
        strlcpy(net.hostname, v, sizeof(net.hostname));
    }
    settings_rlog_t old_rlog;
    settings_get_rlog(&old_rlog);
    settings_rlog_t rlog = old_rlog;
    rlog.enabled = form_get(body, "rlog", v, sizeof(v)) && strcmp(v, "1") == 0;
    if (form_get(body, "rlog_lvl", v, sizeof(v))) {
        long lvl = strtol(v, NULL, 10);
        rlog.level = (lvl < SETTINGS_RLOG_LEVEL_MIN || lvl > SETTINGS_RLOG_LEVEL_MAX) ? 0 : (uint8_t)lvl;
    }
    net.static_ip = form_get(body, "static", v, sizeof(v)) && strcmp(v, "1") == 0;
    if (net.static_ip) {
        const char *keys[] = {"ip", "mask", "gw", "dns"};
        uint32_t *dst[] = {&net.ip, &net.mask, &net.gw, &net.dns};
        for (int i = 0; i < 4; i++) {
            *dst[i] = 0;
            if (form_get(body, keys[i], v, sizeof(v)) && v[0] != '\0' && !netcfg_ipv4_parse(v, dst[i])) {
                snprintf(body, sizeof(body), "%s is not a valid IPv4 address.", keys[i]);
                return fail(req, "400 Bad Request", body, "/bridge");
            }
        }
    }

    /* validate everything before saving anything, so a bad address does not leave half the form applied */
    if (!settings_options_valid(&opt)) {
        return fail(req, "400 Bad Request", "A serial link setting is out of range.", "/bridge");
    }
    if (rlog.level < SETTINGS_RLOG_LEVEL_MIN || rlog.level > SETTINGS_RLOG_LEVEL_MAX) {
        return fail(req, "400 Bad Request", "Unknown remote log level.", "/bridge");
    }
    if (!settings_net_valid(&net)) {
        return fail(req, "400 Bad Request",
                    "Invalid hostname, or the static address, netmask and gateway do not fit together.", "/bridge");
    }
    if (settings_set_options(&opt) != ESP_OK || settings_set_net(&net) != ESP_OK || settings_set_rlog(&rlog) != ESP_OK) {
        return fail(req, "500 Internal Server Error", "Could not save the settings.", "/bridge");
    }
    printer_link_set_target_baud(opt.target_baud);
    if (rlog.enabled != old_rlog.enabled || rlog.level != old_rlog.level) {
        remote_log_apply();
    }

    bool reboot = opt.pins != old_opt.pins || strcmp(net.hostname, old_net.hostname) != 0 ||
                  net.static_ip != old_net.static_ip ||
                  (net.static_ip && (net.ip != old_net.ip || net.mask != old_net.mask || net.gw != old_net.gw ||
                                     net.dns != old_net.dns));
    ESP_LOGI(TAG, "settings saved: baud %lu, pins %d, idle %u s, host %s, %s%s", (unsigned long)opt.target_baud,
             (int)opt.pins, (unsigned)opt.idle_timeout_s, net.hostname, net.static_ip ? "static" : "DHCP",
             reboot ? ", rebooting" : "");
    if (!reboot) {
        return redirect_to(req, "/bridge?done=saved");
    }
    char ip[16];
    ip_str(net.ip, ip);
    char msg[320];
    snprintf(msg, sizeof(msg),
             "<p>Saved. Rebooting. Reconnect at <a href='http://%s.local/'>http://%s.local/</a>%s%s%s.</p>",
             net.hostname, net.hostname, net.static_ip ? " or <a href='http://" : "", net.static_ip ? ip : "",
             net.static_ip ? "/'>that address</a>" : "");
    httpd_resp_set_type(req, "text/html");
    httpd_resp_sendstr_chunk(req, PAGE_HEAD);
    httpd_resp_sendstr_chunk(req, msg);
    send_page_end(req);
    restart_soon();
    return ESP_OK;
}

static esp_err_t link_error(httpd_req_t *req, esp_err_t err)
{
    const char *msg = "Could not send to the printer.";
    if (err == ESP_ERR_TIMEOUT) {
        msg = "The printer is busy printing; nothing was sent.";
    } else if (err == ESP_ERR_NOT_FINISHED) {
        msg = "The printer is paused (XOFF: out of paper or head open?); the command was discarded.";
    } else if (err == ESP_ERR_INVALID_STATE) {
        msg = "The printer is not detected.";
    } else if (err == ESP_ERR_NOT_SUPPORTED) {
        msg = "The printer is not in a ZPL language; nothing was sent.";
    }
    return fail(req, "500 Internal Server Error", msg, "/printer");
}

/* Parse a size in mm ("101.6") into dots; false unless it is a plain number from lo to hi mm. */
static bool parse_mm(const char *text, int dpmm, double lo, double hi, int *dots)
{
    char *end;
    double mm = strtod(text, &end);
    if (end == text || *end != '\0' || !(mm >= lo && mm <= hi)) {
        return false;
    }
    *dots = (int)lround(mm * dpmm);  /* to the nearest dot either side of zero */
    return true;
}

/*
 * POST /printer_config: apply the printer settings form. Each value is
 * parsed and range-checked here; only values that differ from the cached
 * ^HH reading are sent, followed by ^JUS. Lengths come in mm (<key>_mm).
 */
static esp_err_t printer_config_post(httpd_req_t *req)
{
    if (on_ap(req)) {
        return to_setup_page(req);
    }
    if (!same_origin(req)) {
        return cross_site(req);
    }
    char body[BODY_MAX + 1];
    if (!read_form(req, body)) {
        return ESP_FAIL;
    }
    zpl_hh_t *hh = malloc(sizeof(*hh));
    if (hh == NULL) {
        return fail(req, "500 Internal Server Error", "Out of memory.", "/printer");
    }
    bool have;
    int64_t age_ms;
    printer_config(hh, false, &have, &age_ms);
    zpl_printer_cfg_t cur = {0};
    if (have) {
        zpl_cfg_from_hh(hh, &cur);
    }
    free(hh);
    if (!have) {
        return fail(req, "500 Internal Server Error",
                    "The printer's current settings could not be read; nothing was sent.", "/printer");
    }

    zpl_printer_cfg_t want = cur;
    uint32_t changed = 0;
    for (int f = 0; f < ZPL_CFG_COUNT; f++) {
        const zpl_cfg_desc_t *d = zpl_cfg_desc((zpl_cfg_field_t)f);
        char v[16];
        int x;
        if (!(cur.known & (1u << f))) {
            continue;
        }
        char mm_key[24];
        snprintf(mm_key, sizeof(mm_key), "%s_mm", d->key);
        if (cur.dpmm > 0 && form_get(body, mm_key, v, sizeof(v))) {
            /* a length typed in mm: to dots here, then checked against the range as dots */
            int dots;
            if (!parse_mm(v, cur.dpmm, -10000.0, 10000.0, &dots)) {
                char msg[80];
                snprintf(msg, sizeof(msg), "%s is not a number of mm; nothing was sent.", d->key);
                return fail(req, "400 Bad Request", msg, "/printer");
            }
            snprintf(v, sizeof(v), "%d", dots);
        } else if (!form_get(body, d->key, v, sizeof(v))) {
            continue;
        }
        if (!zpl_cfg_parse(&cur, (zpl_cfg_field_t)f, v, &x)) {
            char msg[80];
            snprintf(msg, sizeof(msg), "%s is not a valid value for this printer; nothing was sent.", d->key);
            return fail(req, "400 Bad Request", msg, "/printer");
        }
        if (x != cur.v[f]) {
            want.v[f] = x;
            changed |= 1u << f;
        }
    }
    if (changed == 0) {
        return redirect_to(req, "/printer?done=same");
    }
    char cmd[256];
    if (zpl_cfg_commands(&want, changed, cmd, sizeof(cmd)) == 0) {
        return fail(req, "500 Internal Server Error", "Could not build the printer commands.", "/printer");
    }
    esp_err_t err = printer_link_send_zpl(cmd, pdMS_TO_TICKS(CMD_LINK_WAIT_MS), 500);
    if (err != ESP_OK) {
        return link_error(req, err);
    }
    ESP_LOGI(TAG, "printer settings changed (mask 0x%lx)", (unsigned long)changed);
    return redirect_to(req, "/printer?done=sent");
}

/* POST /printer_action: one-shot printer commands (calibrate, feed, counters, saved and factory settings). */
static esp_err_t printer_action_post(httpd_req_t *req)
{
    if (on_ap(req)) {
        return to_setup_page(req);
    }
    if (!same_origin(req)) {
        return cross_site(req);
    }
    char body[BODY_MAX + 1];
    if (!read_form(req, body)) {
        return ESP_FAIL;
    }
    char action[24] = "";
    form_get(body, "action", action, sizeof(action));
    const char *zpl = zpl_action_command(action);
    if (zpl == NULL) {
        return fail(req, "400 Bad Request", "Unknown printer action.", "/printer");
    }
    /*
     * Factory defaults (and possibly the saved settings) change the
     * printer's serial port. Hold the link while the printer applies them,
     * then rescan, which finds the printer at its new baud and puts it back
     * to the bridge's baud and XON/XOFF with ^SC ... ^JUS.
     */
    bool port_may_change = strcmp(action, "factory_defaults") == 0 || strcmp(action, "reload_saved") == 0;
    esp_err_t err = printer_link_send_zpl(zpl, pdMS_TO_TICKS(CMD_LINK_WAIT_MS), port_may_change ? 3000 : 0);
    if (err != ESP_OK) {
        return link_error(req, err);
    }
    ESP_LOGI(TAG, "printer action %s", action);
    if (port_may_change) {
        printer_link_request_redetect();
    }
    /* action is one zpl_action_command knows, so it is safe in the URL */
    char location[48];
    snprintf(location, sizeof(location), "/printer?done=%s", action);
    return redirect_to(req, location);
}

/* POST /printer_test: print the test label at the size from the form. */
static esp_err_t printer_test_post(httpd_req_t *req)
{
    if (on_ap(req)) {
        return to_setup_page(req);
    }
    if (!same_origin(req)) {
        return cross_site(req);
    }
    char body[BODY_MAX + 1];
    if (!read_form(req, body)) {
        return ESP_FAIL;
    }
    zpl_hh_t *hh = malloc(sizeof(*hh));
    zpl_printer_cfg_t cfg = {0};
    bool have = false;
    int64_t age_ms;
    if (hh != NULL) {
        printer_config(hh, false, &have, &age_ms);
        if (have) {
            zpl_cfg_from_hh(hh, &cfg);
        }
    }
    free(hh);
    if (cfg.dpmm <= 0) {
        return fail(req, "503 Service Unavailable",
                    "The printer's resolution is not known yet: it has not answered the settings read.", "/printer");
    }
    double head_mm = cfg.head_dots > 0 ? (double)cfg.head_dots / cfg.dpmm : 108.0;
    char v[16];
    int w = 0;
    int l = 0;
    if (!form_get(body, "w", v, sizeof(v)) || !parse_mm(v, cfg.dpmm, 10.0, head_mm, &w)) {
        snprintf(body, sizeof(body), "The width must be a number of mm from 10 to %.1f (the printhead's width).",
                 head_mm);
        return fail(req, "400 Bad Request", body, "/printer");
    }
    if (!form_get(body, "l", v, sizeof(v)) || !parse_mm(v, cfg.dpmm, 10.0, 1000.0, &l)) {
        return fail(req, "400 Bad Request", "The length must be a number of mm from 10 to 1000.", "/printer");
    }
    printer_status_t p;
    printer_link_get_status(&p);
    settings_net_t net;
    settings_get_net(&net);
    char url[48];
    snprintf(url, sizeof(url), "http://%s.local/", net.hostname);
    test_label_t t = {.width = w, .length = l, .dpmm = cfg.dpmm, .model = p.model,
                      .version = esp_app_get_description()->version, .url = url};
    char *zpl = malloc(TEST_LABEL_ZPL_MAX);
    if (zpl == NULL) {
        return fail(req, "500 Internal Server Error", "Out of memory.", "/printer");
    }
    if (test_label_zpl(&t, zpl, TEST_LABEL_ZPL_MAX) == 0) {
        free(zpl);
        return fail(req, "500 Internal Server Error", "Could not build the test label.", "/printer");
    }
    esp_err_t err = printer_link_send_zpl(zpl, pdMS_TO_TICKS(CMD_LINK_WAIT_MS), 0);
    free(zpl);
    if (err != ESP_OK) {
        return link_error(req, err);
    }
    ESP_LOGI(TAG, "test label %d x %d dots at %d dots/mm", w, l, cfg.dpmm);
    return redirect_to(req, "/printer?done=test_label");
}

/* POST /update: a new app image as the raw body (see ota_receive); restarts into it. */
static esp_err_t update_post(httpd_req_t *req)
{
    if (on_ap(req)) {
        return to_setup_page(req);
    }
    if (!same_origin(req)) {
        return cross_site(req);
    }
    const char *why;
    esp_err_t err = ota_receive(req, &why);
    httpd_resp_set_type(req, "text/plain");
    if (err != ESP_OK) {
        httpd_resp_set_status(req, err == ESP_ERR_NO_MEM || err == ESP_FAIL ? "500 Internal Server Error"
                                                                             : "400 Bad Request");
        return httpd_resp_sendstr(req, why != NULL ? why : "Update failed.");
    }
    httpd_resp_sendstr(req, "Updated. Restarting into the new firmware; this page reloads in 20 s.");
    restart_soon();
    return ESP_OK;
}

/* POST /boot_other: restart into the firmware in the other slot. */
static esp_err_t boot_other_post(httpd_req_t *req)
{
    if (on_ap(req)) {
        return to_setup_page(req);
    }
    if (!same_origin(req)) {
        return cross_site(req);
    }
    if (ota_boot_other() != ESP_OK) {
        return fail(req, "400 Bad Request", "There is no other valid firmware to go back to.", "/bridge");
    }
    httpd_resp_set_type(req, "text/html");
    httpd_resp_sendstr_chunk(req, PAGE_HEAD);
    httpd_resp_sendstr_chunk(req, "<p>Restarting into the other firmware. <a href=/>Back to the status page</a> in "
                                  "about 20 s.</p>");
    send_page_end(req);
    restart_soon();
    return ESP_OK;
}

static esp_err_t favicon_get(httpd_req_t *req)
{
    httpd_resp_set_type(req, "image/svg+xml");
    httpd_resp_set_hdr(req, "Cache-Control", "max-age=86400");
    return httpd_resp_send(req, s_favicon, sizeof(s_favicon) - 1);
}

/* Bitmap icons for browsers that ignore the SVG one (Safari on iOS); made by assets/logo/make_icons.py */
extern const uint8_t favicon_ico_start[] asm("_binary_favicon_ico_start");
extern const uint8_t favicon_ico_end[] asm("_binary_favicon_ico_end");
extern const uint8_t touch_icon_start[] asm("_binary_apple_touch_icon_png_start");
extern const uint8_t touch_icon_end[] asm("_binary_apple_touch_icon_png_end");

static esp_err_t icon_get(httpd_req_t *req)
{
    bool ico = strcmp(req->uri, "/favicon.ico") == 0;
    httpd_resp_set_type(req, ico ? "image/x-icon" : "image/png");
    httpd_resp_set_hdr(req, "Cache-Control", "max-age=86400");
    const uint8_t *start = ico ? favicon_ico_start : touch_icon_start;
    const uint8_t *end = ico ? favicon_ico_end : touch_icon_end;
    return httpd_resp_send(req, (const char *)start, end - start);
}

static esp_err_t redetect_post(httpd_req_t *req)
{
    if (on_ap(req)) {
        return to_setup_page(req);
    }
    if (!same_origin(req)) {
        return cross_site(req);
    }
    printer_link_request_redetect();
    return redirect_to(req, "/printer?done=redetect");
}

/* POST /wifi_join: try another network, keeping the current one if it fails (wifi_prov_join). */
static esp_err_t wifi_join_post(httpd_req_t *req)
{
    if (on_ap(req)) {
        return to_setup_page(req);
    }
    if (!same_origin(req)) {
        return cross_site(req);
    }
    char body[BODY_MAX + 1];
    if (!read_form(req, body)) {
        return ESP_FAIL;
    }
    char ssid[SETTINGS_SSID_MAX] = "";
    char pass[SETTINGS_PASS_MAX] = "";
    form_get(body, "ssid", ssid, sizeof(ssid));
    form_get(body, "pass", pass, sizeof(pass));
    memset(body, 0, sizeof(body));
    if (ssid[0] == '\0') {
        return fail(req, "400 Bad Request", "No network chosen.", "/bridge#wifi");
    }
    if (pass[0] != '\0' && strlen(pass) < 8) {
        memset(pass, 0, sizeof(pass));
        return fail(req, "400 Bad Request", "WPA passwords are at least 8 characters.", "/bridge#wifi");
    }
    esp_err_t err = wifi_prov_join(ssid, pass);
    memset(pass, 0, sizeof(pass));
    if (err == ESP_ERR_INVALID_STATE) {
        return fail(req, "409 Conflict", "A join is already running, or Wi-Fi is not connected.", "/bridge#wifi");
    }
    if (err != ESP_OK) {
        return fail(req, "400 Bad Request", "That network name or password is too long.", "/bridge#wifi");
    }
    ESP_LOGI(TAG, "joining WiFi network \"%s\" from the web page", ssid);
    /* the status page polls, so it shows the join's outcome while the bridge is still reachable here */
    return redirect_to(req, "/");
}

static esp_err_t forget_post(httpd_req_t *req)
{
    if (on_ap(req)) {
        return to_setup_page(req);
    }
    if (!same_origin(req)) {
        return cross_site(req);
    }
    settings_clear_wifi();
    ESP_LOGW(TAG, "WiFi credentials cleared from the web page, rebooting");
    httpd_resp_set_type(req, "text/html");
    httpd_resp_sendstr_chunk(req, PAGE_HEAD);
    char buf[256];
    snprintf(buf, sizeof(buf),
             "<p>Wi-Fi forgotten. The bridge is restarting in setup mode: join the open network <b>%s</b> "
             "and open <a href='" AP_HOME "'>" AP_HOME "</a> to choose a network.</p>",
             wifi_prov_ap_ssid());
    httpd_resp_sendstr_chunk(req, buf);
    send_page_end(req);
    restart_soon();
    return ESP_OK;
}

/* Captive portal: any unknown URL asked over the setup AP goes to the setup page. */
static esp_err_t not_found(httpd_req_t *req, httpd_err_code_t err)
{
    (void)err;
    if (on_ap(req)) {
        return to_setup_page(req);
    }
    return httpd_resp_send_err(req, HTTPD_404_NOT_FOUND, "not found");
}

void web_start(void)
{
    httpd_config_t cfg = HTTPD_DEFAULT_CONFIG();
    cfg.max_open_sockets = 4;
    cfg.stack_size = 8192;
    cfg.lru_purge_enable = true;
    cfg.max_uri_handlers = 24;
    httpd_handle_t server;
    if (httpd_start(&server, &cfg) != ESP_OK) {
        ESP_LOGE(TAG, "HTTP server failed to start");
        return;
    }
    const httpd_uri_t uris[] = {
        {.uri = "/", .method = HTTP_GET, .handler = root_get},
        {.uri = "/save", .method = HTTP_POST, .handler = save_post},
        {.uri = "/api/status", .method = HTTP_GET, .handler = status_get},
        {.uri = "/favicon.svg", .method = HTTP_GET, .handler = favicon_get},
        {.uri = "/favicon.ico", .method = HTTP_GET, .handler = icon_get},
        {.uri = "/apple-touch-icon.png", .method = HTTP_GET, .handler = icon_get},
        {.uri = "/apple-touch-icon-precomposed.png", .method = HTTP_GET, .handler = icon_get},
        {.uri = "/settings", .method = HTTP_GET, .handler = settings_get_page},
        {.uri = "/printer", .method = HTTP_GET, .handler = printer_get_page},
        {.uri = "/bridge", .method = HTTP_GET, .handler = bridge_get_page},
        {.uri = "/wifi_join", .method = HTTP_POST, .handler = wifi_join_post},
        {.uri = "/config", .method = HTTP_POST, .handler = config_post},
        {.uri = "/redetect", .method = HTTP_POST, .handler = redetect_post},
        {.uri = "/forget", .method = HTTP_POST, .handler = forget_post},
        {.uri = "/api/printer_config", .method = HTTP_GET, .handler = printer_config_get},
        {.uri = "/printer_config", .method = HTTP_POST, .handler = printer_config_post},
        {.uri = "/printer_action", .method = HTTP_POST, .handler = printer_action_post},
        {.uri = "/printer_test", .method = HTTP_POST, .handler = printer_test_post},
        {.uri = "/update", .method = HTTP_POST, .handler = update_post},
        {.uri = "/boot_other", .method = HTTP_POST, .handler = boot_other_post},
    };
    for (size_t i = 0; i < sizeof(uris) / sizeof(uris[0]); i++) {
        esp_err_t err = httpd_register_uri_handler(server, &uris[i]);
        if (err != ESP_OK) {
            ESP_LOGE(TAG, "cannot register %s: %s", uris[i].uri, esp_err_to_name(err));
        }
    }
    httpd_register_err_handler(server, HTTPD_404_NOT_FOUND, not_found);
    ESP_LOGI(TAG, "HTTP server on port 80");
}
